## CMakeLists.txt
```
# SPDX-License-Identifier: Apache-2.0

cmake_minimum_required(VERSION 3.20.0)
find_package(Zephyr REQUIRED HINTS $ENV{ZEPHYR_BASE})
project(base_node_observer2)

FILE(GLOB app_sources src/*.c)

FILE(GLOB lib_sources)



# Tell CMake to build with the app and lib sources
target_sources(app PRIVATE ${app_sources} ${lib_sources})

# Tell CMake where our header files are
target_include_directories(app PRIVATE ../../include)
```

## prj.conf
```kconfig
CONFIG_BT=y
CONFIG_BT_OBSERVER=y
CONFIG_PRINTK=y

CONFIG_SHELL=y
CONFIG_SHELL_BACKEND_SERIAL=y

CONFIG_LOG=y
CONFIG_LOG_DEFAULT_LEVEL=3 
CONFIG_SHELL_LOG_BACKEND=y  

CONFIG_LOG_CMDS=y
CONFIG_LOG_RUNTIME_FILTERING=y


CONFIG_HEAP_MEM_POOL_SIZE=2048



CONFIG_NEWLIB_LIBC_FLOAT_PRINTF=y
CONFIG_CBPRINTF_FP_SUPPORT=y 
```

## src/main.c
```c
/*
 * Copyright (c) 2022 Nordic Semiconductor ASA
 *
 * SPDX-License-Identifier: Apache-2.0
 */

#include <zephyr/sys/printk.h>
#include <zephyr/bluetooth/bluetooth.h>

int observer_start(void);
extern void print_rssi_buffer(void);

int main(void)
{
	int err;

	printk("Starting Observer Demo\n");

	/* Initialize the Bluetooth Subsystem */
	err = bt_enable(NULL);
	if (err) {
		printk("Bluetooth init failed (err %d)\n", err);
		return 0;
	}

	err = observer_start();
	if (err) {
		printk("Observer start failed (err %d)\n", err);
		return 0;
	}

	// Keep the main thread running
	while (1) {
		k_sleep(K_SECONDS(3));
        print_rssi_buffer();
	}

	return 0;
}
```

## src/kalman_filter.c
```c
#include <stdlib.h>


#include <stdio.h>
#include <zephyr/kernel.h>
#include <zephyr/drivers/gpio.h>
#include <zephyr/shell/shell.h>
#include <zephyr/logging/log.h>
#include <zephyr/logging/log_ctrl.h>

LOG_MODULE_REGISTER(test_kal_module, LOG_LEVEL_DBG);


// Kalman filter variables
float kalmanGain = 0.0;   // estimated value
float estError = 1.0;   // estimation error
float measErr = 0.1; // process noise

float estimate = 0.0; // inital estimate
float measurement; 

  // measurement noise


float weight_value(float ultrasonicMeas, float rssiMeas) 
{ 

    float ultraWeight = 0.95; // 95% ultrasonic
    float rssiWeight = 0.05; // 5 % rssi 

    float weightedUltMeas = ultraWeight * ultrasonicMeas; 
    float weightedRssiMeas = rssiWeight * rssiMeas; 

    float weightAvg = weightedUltMeas + weightedRssiMeas; 

    return weightAvg; 

}

float kalman_update(float measurement) {
    // Prediction update

    kalmanGain = estError/(estError + measErr); 

    estimate = estimate + (kalmanGain * (measurement - estimate)); 

    estError = (1.0 - kalmanGain) * (estError); 

    return estimate; 
}

float get_kalman_position(float ultrasonicMeas, float rssiMeas) { 

    float weighted_val = weight_value(ultrasonicMeas, rssiMeas); 

    float est = kalman_update(weighted_val); 

    return est; 
}
```

## src/node_filtering.c
```c
#include <stdio.h>
#include <zephyr/kernel.h>
#include <zephyr/drivers/gpio.h>
#include <zephyr/shell/shell.h>
#include <zephyr/logging/log.h>
#include <zephyr/logging/log_ctrl.h>

#include <zephyr/sys/util.h>

#include <zephyr/bluetooth/bluetooth.h>
#include <zephyr/bluetooth/hci.h>

#include <string.h>



#include <zephyr/sys/slist.h>

LOG_MODULE_REGISTER(Node_filtering, LOG_LEVEL_DBG);

static sys_slist_t ibeacon_list; // list to hold the ibeacons

// ibeacon_node structure
struct ibeacon_node { 

    sys_snode_t node;

    char ble_name[32];
    char mac_addr[17];
    int major;
    int minor;
    float x;
    float y;
    char left_neighbor[32];
    char right_neighbor[32];
}; 

// list of known nodes
static const struct ibeacon_node knownBeacons[] = { 
    { 
        .ble_name = "4011-A", 
        .mac_addr = "F5:75:FE:85:34:67", 
        .major = 2753, 
        .minor = 32998, 
        .x = 0, 
        .y = 0 , 
        // need left nd right neighbors
    }, 
    { 
        .ble_name = "4011-B", 
        .mac_addr = "E5:73:87:06:1E:86", 
        .major = 32975, 
        .minor = 20959, 
        .x = 1.5, 
        .y = 0, 
        // need left nd right neighbors
    }, 
    { 
        .ble_name = "4011-C", 
        .mac_addr = "CA:99:9E:FD:98:B1", 
        .major = 26679, 
        .minor = 40363, 
        .x = 3, 
        .y = 0, 
        // need left nd right neighbors
    }, 
    { 
        .ble_name = "4011-D", 
        .mac_addr = "CB:1B:89:82:FF:FE", 
        .major = 41747, 
        .minor = 38800, 
        .x = 3, 
        .y = 2, 
        // need left nd right neighbors
    }, 
    { 
        .ble_name = "4011-E", 
        .mac_addr = "D4:D2:A0:A4:5C:AC", 
        .major = 30679, 
        .minor = 51963, 
        .x = 3, 
        .y = 4, 
        // need left nd right neighbors
    }, 
    { 
        .ble_name = "4011-F", 
        .mac_addr = "C1:13:27:E9:B7:7C", 
        .major = 6195, 
        .minor = 18394, 
        .x = 1.5, 
        .y = 4, 
        // need left nd right neighbors
    }, 
    { 
        .ble_name = "4011-G", 
        .mac_addr = "F1:04:48:06:39:A0", 
        .major = 30525, 
        .minor = 30544, 
        .x = 0, 
        .y = 4, 
        // need left nd right neighbors
    }, 
    { 
        .ble_name = "4011-H", 
        .mac_addr = "CA:0C:E0:DB:CE:60", 
        .major = 57395, 
        .minor = 28931, 
        .x = 0, 
        .y = 2, 
        // need left nd right neighbors
    }, 
    { 
        .ble_name = "4011-I", 
        .mac_addr = "D4:7F:D4:7C:20:13", 
        .major = 60345, 
        .minor = 49995, 
        .x = 4.5, 
        .y = 0, 
        // need left nd right neighbors
    }, 
    { 
        .ble_name = "4011-J", 
        .mac_addr = "F7:0B:21:F1:C8:E1", 
        .major = 12249, 
        .minor = 30916, 
        .x = 6, 
        .y = 0, 
        // need left nd right neighbors
    }, 
    { 
        .ble_name = "4011-K", 
        .mac_addr = "FD:E0:8D:FA:3E:4A", 
        .major = 36748, 
        .minor = 11457, 
        .x = 6, 
        .y = 2, 
        // need left nd right neighbors
    }, 
    { 
        .ble_name = "4011-L", 
        .mac_addr = "EE:32:F7:28:FA:AC", 
        .major = 27564, 
        .minor = 27589 , 
        .x = 6, 
        .y = 4, 
        // need left nd right neighbors
    }, 
    { 
        .ble_name = "4011-M", 
        .mac_addr = "F7:3B:46:A8:D7:2C", 
        .major = 49247, 
        .minor = 52925, 
        .x = 4.5, 
        .y = 4, 
        // need left nd right neighbors
    },  
}; 

static int cmd_add_beacon(const struct shell *shell, size_t argc, char **argv) 
{ 

    char* nodeName = argv[1]; // get entered name

    bool beaconFound = false; // Flag to check whether the entered beacon is in the list of known beacons

    for (int beaconNumber = 0; beaconNumber < ARRAY_SIZE(knownBeacons); beaconNumber++) { 
        if (strcmp(knownBeacons[beaconNumber].ble_name, nodeName) == 0) { 
            struct ibeacon_node *new_ibeacon = k_malloc(sizeof(struct ibeacon_node)); 

            if (!new_ibeacon) { 
                LOG_ERR("Unable to add new iBeacon"); 
                return -ENOMEM; 
            }

            *new_ibeacon = knownBeacons[beaconNumber];  // Set the new beacon info to the info held in the list

            sys_slist_append(&ibeacon_list, &new_ibeacon->node);    // append the new beacon to the list of beacons

            beaconFound = true; // set flag to indicate the beacon was in the known beacon list
        }
    }

    // If the beacon was not within the list, log error
    if (!beaconFound) { 
        LOG_ERR("Not valid iBeacon"); 
        return 1; 
    }

    return 0; 

}

static int cmd_remove_beacon(const struct shell *shell, size_t argc, char **argv) 
{ 
    char* nodeName = argv[1]; 
    
    struct ibeacon_node *node; 
    struct ibeacon_node *prev = NET_BUF_EXTERNAL_DATA; 


    SYS_SLIST_FOR_EACH_CONTAINER(&ibeacon_list, node, node) {

        if (strcmp(node->ble_name, nodeName) == 0) {
            // Remove from list
            sys_slist_remove(&ibeacon_list,
                             prev ? &prev->node : NULL,
                             &node->node);

            k_free(node);
            LOG_INF("%s removed from current ibeacons", nodeName); 
            return 0;
        }
        prev = node;
    }

    return 0; 
}

static int cmd_show_active(const struct shell *shell, size_t argc, char **argv)
{
    struct ibeacon_node *node;

    SYS_SLIST_FOR_EACH_CONTAINER(&ibeacon_list, node, node) {

        printk("%s [%s] Major: %d Minor: %d Pos: (%.1f, %.1f)\n",
            node->ble_name, node->mac_addr, node->major, node->minor, node->x, node->y);
    }

    if (sys_slist_is_empty(&ibeacon_list)) { 
        LOG_INF("No iBeacons currently selected"); 
    }

    return 0;
}

// Register shell commands
SHELL_STATIC_SUBCMD_SET_CREATE(
    sub_beacon,
    SHELL_CMD(add, NULL, "Add known beacon by name", cmd_add_beacon),
    SHELL_CMD(show, NULL, "Show active beacons", cmd_show_active),
    SHELL_CMD(remove, NULL, "Remove beacon by name", cmd_remove_beacon),
    SHELL_SUBCMD_SET_END
);

SHELL_CMD_REGISTER(beacon, &sub_beacon, "Beacon list operations", NULL);

// Init list on boot
static int beacon_list_init(const struct device *dev)
{
    ARG_UNUSED(dev);
    sys_slist_init(&ibeacon_list);
    return 0;
}

SYS_INIT(beacon_list_init, APPLICATION, CONFIG_APPLICATION_INIT_PRIORITY); 
```

## src/observer.c
```c
/*
 * Copyright (c) 2022 Nordic Semiconductor ASA
 * Copyright (c) 2015-2016 Intel Corporation
 *
 * SPDX-License-Identifier: Apache-2.0
 */

#include <zephyr/sys/printk.h>
#include <zephyr/bluetooth/bluetooth.h>
#include <zephyr/bluetooth/hci.h>

#define NAME_LEN 30

#define NUM_BEACONS 8
#define BUFFER_SIZE (NUM_BEACONS + 1)  // 8 RSSI values + 1 for ultrasonic distance

int16_t rssi_buffer[BUFFER_SIZE];


// Function Declarations
static bool extract_rssi_values(struct net_buf_simple *ad, int8_t *rssi_values);
static bool is_our_ibeacon(struct net_buf_simple *ad);
static void device_found(const bt_addr_le_t *addr, int8_t rssi, uint8_t type, struct net_buf_simple *ad);
int observer_start(void);
extern void print_rssi_buffer(void);


void print_rssi_buffer(void) {
    printk("RSSI Buffer values:\n");
    for (int i = 0; i < NUM_BEACONS; i++) {
        printk("Beacon %d: %d\n", i + 1, rssi_buffer[i]);
    }
    printk("Ultrasonic distance: %d\n", rssi_buffer[NUM_BEACONS]);
}




static bool is_our_ibeacon(struct net_buf_simple *ad)
{
    uint8_t len, type;
    while (ad->len > 1) {
        len = net_buf_simple_pull_u8(ad);
        if (len == 0) {
            break;
        }
        type = net_buf_simple_pull_u8(ad);
        
        if (type == BT_DATA_MANUFACTURER_DATA && len >= 4) {
            if (ad->data[0] == 0x4D && ad->data[1] == 0x00) { // 0x4D is our unqiue identifier
                if (ad->data[2] == 0x02 && ad->data[3] == 0x15) {
                    return true;
                }
            }
        }
        net_buf_simple_pull(ad, len - 1);
    }
    return false;
}

static void device_found(const bt_addr_le_t *addr, int8_t rssi, uint8_t type,
                         struct net_buf_simple *ad)
{
    char addr_str[BT_ADDR_LE_STR_LEN];
    bt_addr_le_to_str(addr, addr_str, sizeof(addr_str));

    struct net_buf_simple_state state;
    net_buf_simple_save(ad, &state);

    if (is_our_ibeacon(ad)) {
        struct net_buf_simple_state state;
        net_buf_simple_save(ad, &state);

        //printk("Ultrasonic Node found: %s (RSSI %d)\n", addr_str, rssi);

        const uint8_t *data = ad->data;
        uint16_t dist = ((uint16_t)data[4] << 8) | data[5];
        //printk("Ultrasonic distance: %d\n", dist);
        rssi_buffer[NUM_BEACONS] = dist;
        net_buf_simple_restore(ad, &state);
        return;
    }

    net_buf_simple_restore(ad, &state);

    if (strncmp(addr_str, "D2:9B:44:CE:1A:EC", 17) == 0) {
        struct net_buf_simple_state state;
        int8_t beacon_rssi[8];

        net_buf_simple_save(ad, &state);

        if (extract_rssi_values(ad, beacon_rssi)) {
            // printk("\nMobile Node Update (MAC: %s)\n", addr_str);
            // printk("Direct RSSI: %d\n", rssi);
            // printk("Beacon RSSI values:\n");
            for (int i = 0; i < 8; i++) {
                rssi_buffer[i] = beacon_rssi[i];
              //  printk("Beacon %d: %d dBm\n", i + 1, beacon_rssi[i]);
            }
        }

        net_buf_simple_restore(ad, &state);
    }
}



// Function to extract RSSI values from manufacturer data
static bool extract_rssi_values(struct net_buf_simple *ad, int8_t *rssi_values) {
    while (ad->len > 1) {
        uint8_t len = net_buf_simple_pull_u8(ad);
        uint8_t type;

        if (len == 0) {
            break;
        }

        type = net_buf_simple_pull_u8(ad);

        if (type == BT_DATA_MANUFACTURER_DATA && len >= 4) {  
            const uint8_t *rssi_data = &ad->data[4];
            
            for (int i = 0; i < 8; i++) {
                rssi_values[i] = (int8_t)rssi_data[i];
            }
            return true;
        
        }
        
        net_buf_simple_pull(ad, len - 1);
    }
    return false;
}






#if defined(CONFIG_BT_EXT_ADV)
static bool data_cb(struct bt_data *data, void *user_data)
{
	char *name = user_data;
	uint8_t len;

	switch (data->type) {
	case BT_DATA_NAME_SHORTENED:
	case BT_DATA_NAME_COMPLETE:
		len = MIN(data->data_len, NAME_LEN - 1);
		(void)memcpy(name, data->data, len);
		name[len] = '\0';
		return false;
	default:
		return true;
	}
}

static const char *phy2str(uint8_t phy)
{
	switch (phy) {
	case BT_GAP_LE_PHY_NONE: return "No packets";
	case BT_GAP_LE_PHY_1M: return "LE 1M";
	case BT_GAP_LE_PHY_2M: return "LE 2M";
	case BT_GAP_LE_PHY_CODED: return "LE Coded";
	default: return "Unknown";
	}
}

static void scan_recv(const struct bt_le_scan_recv_info *info,
		      struct net_buf_simple *buf)
{
	char le_addr[BT_ADDR_LE_STR_LEN];
	char name[NAME_LEN];
	uint8_t data_status;
	uint16_t data_len;

	(void)memset(name, 0, sizeof(name));

	data_len = buf->len;
	bt_data_parse(buf, data_cb, name);

	data_status = BT_HCI_LE_ADV_EVT_TYPE_DATA_STATUS(info->adv_props);

	bt_addr_le_to_str(info->addr, le_addr, sizeof(le_addr));
	printk("[DEVICE]: %s, AD evt type %u, Tx Pwr: %i, RSSI %i "
	       "Data status: %u, AD data len: %u Name: %s "
	       "C:%u S:%u D:%u SR:%u E:%u Pri PHY: %s, Sec PHY: %s, "
	       "Interval: 0x%04x (%u ms), SID: %u\n",
	       le_addr, info->adv_type, info->tx_power, info->rssi,
	       data_status, data_len, name,
	       (info->adv_props & BT_GAP_ADV_PROP_CONNECTABLE) != 0,
	       (info->adv_props & BT_GAP_ADV_PROP_SCANNABLE) != 0,
	       (info->adv_props & BT_GAP_ADV_PROP_DIRECTED) != 0,
	       (info->adv_props & BT_GAP_ADV_PROP_SCAN_RESPONSE) != 0,
	       (info->adv_props & BT_GAP_ADV_PROP_EXT_ADV) != 0,
	       phy2str(info->primary_phy), phy2str(info->secondary_phy),
	       info->interval, info->interval * 5 / 4, info->sid);
}

static struct bt_le_scan_cb scan_callbacks = {
	.recv = scan_recv,
};
#endif /* CONFIG_BT_EXT_ADV */

int observer_start(void)
{
	struct bt_le_scan_param scan_param = {
		.type       = BT_LE_SCAN_TYPE_PASSIVE,
		.options    = BT_LE_SCAN_OPT_FILTER_DUPLICATE,
		.interval   = BT_GAP_SCAN_FAST_INTERVAL,
		.window     = BT_GAP_SCAN_FAST_WINDOW,
	};
	int err;

#if defined(CONFIG_BT_EXT_ADV)
	bt_le_scan_cb_register(&scan_callbacks);
	printk("Registered scan callbacks\n");
#endif /* CONFIG_BT_EXT_ADV */

	err = bt_le_scan_start(&scan_param, device_found);
	if (err) {
		printk("Start scanning failed (err %d)\n", err);
		return err;
	}
	printk("Started scanning...\n");

	return 0;
}
```

## src/tracking.c
```c
#include <zephyr/sys/printk.h>
#include <zephyr/bluetooth/bluetooth.h>
#include <zephyr/bluetooth/hci.h>
#include <math.h>

#define NAME_LEN 30
#define NUM_BEACONS 8


// iBeacon positions in meters
float ibeacon_coords[8][2] = {
    {0.0, 0.0},  // iBeacon 1 (A)
    {0.0, 1.5},  // iBeacon 2 (B)
    {0.0, 3.0},  // iBeacon 3 (C)
    {2.0, 3.0},  // iBeacon 4 (D)
    {4.0, 3.0},  // iBeacon 5 (E)
    {4.0, 1.5},  // iBeacon 6 (F)
    {4.0, 0.0},  // iBeacon 7 (G)
    {2.0, 0.0},  // iBeacon 8 (H)
};


// RSSI to distance conversion (simple log-distance model)
float rssi_to_distance(float rssi, float tx_power, float path_loss_exp) {
    return powf(10.0f, (tx_power - rssi) / (10.0f * path_loss_exp));
}

// Solve 2D position using least squares multilateration
void estimate_position(float *distances, float *x_est, float *y_est) {
    float A[NUM_BEACONS - 1][2];
    float b[NUM_BEACONS - 1];

    float x1 = ibeacon_coords[0][0];
    float y1 = ibeacon_coords[0][1];
    float r1 = distances[0];

    // Construct A and b
    for (int i = 1; i < NUM_BEACONS; ++i) {
        float xi = ibeacon_coords[i][0];
        float yi = ibeacon_coords[i][1];
        float ri = distances[i];

        A[i - 1][0] = 2 * (xi - x1);
        A[i - 1][1] = 2 * (yi - y1);

        b[i - 1] = pow(ri, 2) - pow(r1, 2)
                 - pow(xi, 2) + pow(x1, 2)
                 - pow(yi, 2) + pow(y1, 2);
    }

    // Calculate (A^T * A)
    float AtA[2][2] = {{0}};
    for (int i = 0; i < NUM_BEACONS - 1; ++i) {
        AtA[0][0] += A[i][0] * A[i][0];
        AtA[0][1] += A[i][0] * A[i][1];
        AtA[1][0] += A[i][1] * A[i][0];
        AtA[1][1] += A[i][1] * A[i][1];
    }

    // Calculate (A^T * b)
    float Atb[2] = {0};
    for (int i = 0; i < NUM_BEACONS - 1; ++i) {
        Atb[0] += A[i][0] * b[i];
        Atb[1] += A[i][1] * b[i];
    }

    // Invert 2x2 matrix AtA
    float det = AtA[0][0]*AtA[1][1] - AtA[0][1]*AtA[1][0];
    if (fabs(det) < 1e-6) {
        *x_est = 0;
        *y_est = 0;
        return;
    }

    float invAtA[2][2] = {
        { AtA[1][1] / det, -AtA[0][1] / det },
        { -AtA[1][0] / det, AtA[0][0] / det }
    };

    // Multiply inverse with Atb: (AtA)^-1 * Atb
    *x_est = invAtA[0][0] * Atb[0] + invAtA[0][1] * Atb[1];
    *y_est = invAtA[1][0] * Atb[0] + invAtA[1][1] * Atb[1];
}
```
